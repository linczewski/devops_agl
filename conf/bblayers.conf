## conf/bblayers.conf
```bitbake
# POKY_BBLAYERS_CONF_VERSION is increased each time build/conf/bblayers.conf
# changes incompatibly
POKY_BBLAYERS_CONF_VERSION = "2"

BBPATH = "${TOPDIR}"
BBFILES ?= ""

BBLAYERS ?= " \
  /home/agl/salmon/external/poky/meta \
  /home/agl/salmon/external/poky/meta-poky \
  /home/agl/salmon/external/poky/meta-yocto-bsp \
  /home/agl/salmon/bsp/meta-riscv \
  "
```
